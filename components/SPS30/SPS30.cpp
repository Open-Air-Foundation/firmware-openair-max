/*
 * The SHDLC framing in this file is derived from the Sensirion SPS30 UART
 * driver generated by sensirion-driver-generator 1.3.4.
 *
 * Copyright (c) 2025, Sensirion AG
 * All rights reserved.
 *
 * Redistribution and use in source and binary forms, with or without
 * modification, are permitted provided that the following conditions are met:
 *
 * * Redistributions of source code must retain the above copyright notice,
 *   this list of conditions and the following disclaimer.
 *
 * * Redistributions in binary form must reproduce the above copyright notice,
 *   this list of conditions and the following disclaimer in the documentation
 *   and/or other materials provided with the distribution.
 *
 * * Neither the name of Sensirion AG nor the names of its contributors may be
 *   used to endorse or promote products derived from this software without
 *   specific prior written permission.
 *
 * THIS SOFTWARE IS PROVIDED BY THE COPYRIGHT HOLDERS AND CONTRIBUTORS "AS IS"
 * AND ANY EXPRESS OR IMPLIED WARRANTIES, INCLUDING, BUT NOT LIMITED TO, THE
 * IMPLIED WARRANTIES OF MERCHANTABILITY AND FITNESS FOR A PARTICULAR PURPOSE
 * ARE DISCLAIMED. IN NO EVENT SHALL THE COPYRIGHT HOLDER OR CONTRIBUTORS BE
 * LIABLE FOR ANY DIRECT, INDIRECT, INCIDENTAL, SPECIAL, EXEMPLARY, OR
 * CONSEQUENTIAL DAMAGES (INCLUDING, BUT NOT LIMITED TO, PROCUREMENT OF
 * SUBSTITUTE GOODS OR SERVICES; LOSS OF USE, DATA, OR PROFITS; OR BUSINESS
 * INTERRUPTION) HOWEVER CAUSED AND ON ANY THEORY OF LIABILITY, WHETHER IN
 * CONTRACT, STRICT LIABILITY, OR TORT (INCLUDING NEGLIGENCE OR OTHERWISE)
 * ARISING IN ANY WAY OUT OF THE USE OF THIS SOFTWARE, EVEN IF ADVISED OF THE
 * POSSIBILITY OF SUCH DAMAGE.
 */

#include "SPS30.h"

#include <string.h>

#include "esp_log.h"
#include "esp_timer.h"
#include "freertos/FreeRTOS.h"
#include "freertos/task.h"

namespace {
constexpr const char *TAG = "SPS30";

constexpr uint8_t SHDLC_DELIMITER = 0x7e;
constexpr uint8_t SHDLC_ESCAPE = 0x7d;
constexpr uint8_t SHDLC_XON = 0x11;
constexpr uint8_t SHDLC_XOFF = 0x13;
constexpr uint8_t SHDLC_ESCAPE_MASK = 0x20;
constexpr uint8_t SHDLC_ADDRESS = 0x00;

constexpr uint8_t START_MEASUREMENT_COMMAND = 0x00;
constexpr uint8_t STOP_MEASUREMENT_COMMAND = 0x01;
constexpr uint8_t READ_MEASUREMENT_COMMAND = 0x03;
constexpr uint8_t READ_DEVICE_INFORMATION_COMMAND = 0xd0;
constexpr uint8_t DEVICE_RESET_COMMAND = 0xd3;

constexpr uint8_t SERIAL_NUMBER_SUBCOMMAND = 0x03;
constexpr uint8_t FLOAT_OUTPUT_FORMAT[] = {0x01, 0x03};
constexpr size_t SERIAL_NUMBER_SIZE = 32;
constexpr size_t MEASUREMENT_SIZE = 40;

bool is_reserved_byte(uint8_t value) {
  return value == SHDLC_DELIMITER || value == SHDLC_ESCAPE || value == SHDLC_XON ||
         value == SHDLC_XOFF;
}
} // namespace

SPS30::SPS30(AirgradientSerial *serial) : _serial(serial) {}

bool SPS30::begin() {
  if (_is_initialized) {
    return true;
  }
  if (_serial == nullptr) {
    return false;
  }

  _is_connected = false;
  _consecutive_errors = 0;

  _serial->end();
  vTaskDelay(pdMS_TO_TICKS(100));
  if (!_serial->begin(115200)) {
    return false;
  }

  while (_serial->available() > 0) {
    _serial->read();
  }

  _execute_command(DEVICE_RESET_COMMAND, nullptr, 0, nullptr, 0);
  vTaskDelay(pdMS_TO_TICKS(100));
  _execute_command(STOP_MEASUREMENT_COMMAND, nullptr, 0, nullptr, 0);

  uint8_t serial_number[SERIAL_NUMBER_SIZE + 1] = {};
  const uint8_t serial_number_subcommand = SERIAL_NUMBER_SUBCOMMAND;
  size_t serial_number_size = 0;
  if (!_execute_command(READ_DEVICE_INFORMATION_COMMAND, &serial_number_subcommand, 1,
                        serial_number, SERIAL_NUMBER_SIZE, &serial_number_size)) {
    ESP_LOGE(TAG, "Failed to read serial number");
    return false;
  }
  if (serial_number_size == 0) {
    ESP_LOGE(TAG, "Serial number response is empty");
    return false;
  }
  serial_number[serial_number_size] = '\0';
  ESP_LOGI(TAG, "Serial number: %s", reinterpret_cast<const char *>(serial_number));

  if (!_execute_command(START_MEASUREMENT_COMMAND, FLOAT_OUTPUT_FORMAT, sizeof(FLOAT_OUTPUT_FORMAT),
                        nullptr, 0)) {
    ESP_LOGE(TAG, "Failed to start measurements");
    return false;
  }
  ESP_LOGI(TAG, "Measurements started");

  _is_initialized = true;
  _is_connected = true;
  return true;
}

void SPS30::end() {
  if (!_is_initialized) {
    return;
  }

  _execute_command(STOP_MEASUREMENT_COMMAND, nullptr, 0, nullptr, 0);
  _is_initialized = false;
  _is_connected = false;
  _consecutive_errors = 0;
}

bool SPS30::read(Data &data) {
  if (!_is_initialized) {
    return false;
  }

  uint8_t response[MEASUREMENT_SIZE] = {};
  size_t response_size = 0;
  const bool read_success = _execute_command(READ_MEASUREMENT_COMMAND, nullptr, 0, response,
                                             sizeof(response), &response_size);
  if (read_success && response_size != MEASUREMENT_SIZE) {
    ESP_LOGE(TAG, "Measurement response length is invalid");
  }
  if (!read_success || response_size != MEASUREMENT_SIZE) {
    if (_consecutive_errors < UINT8_MAX) {
      ++_consecutive_errors;
    }
    if (_consecutive_errors >= MAX_CONSECUTIVE_ERRORS) {
      _is_connected = false;
    }
    return false;
  }

  Data measurement = {};
  measurement.pm_ae_1_0 = _read_float(&response[0]);
  measurement.pm_ae_2_5 = _read_float(&response[4]);
  measurement.pm_ae_4_0 = _read_float(&response[8]);
  measurement.pm_ae_10_0 = _read_float(&response[12]);
  measurement.pm_raw_0_5 = _read_float(&response[16]);
  measurement.pm_raw_1_0 = _read_float(&response[20]);
  measurement.pm_raw_2_5 = _read_float(&response[24]);
  measurement.pm_raw_4_0 = _read_float(&response[28]);
  measurement.pm_raw_10_0 = _read_float(&response[32]);
  measurement.typical_particle_size = _read_float(&response[36]);

  data = measurement;
  _consecutive_errors = 0;
  _is_connected = true;
  return true;
}

bool SPS30::connected() const { return _is_connected; }

bool SPS30::_execute_command(uint8_t command, const uint8_t *command_data, size_t command_data_size,
                             uint8_t *response_data, size_t response_capacity,
                             size_t *response_size) {
  if (_serial == nullptr || command_data_size > UINT8_MAX || response_capacity > MAX_PAYLOAD_SIZE ||
      (command_data_size > 0 && command_data == nullptr) ||
      (response_capacity > 0 && response_data == nullptr)) {
    ESP_LOGE(TAG, "Command 0x%02x has invalid arguments", command);
    return false;
  }

  if (!_write_frame(command, command_data, command_data_size)) {
    ESP_LOGE(TAG, "Command 0x%02x write failed", command);
    return false;
  }

  size_t actual_response_size = 0;
  const bool success = _read_frame(command, response_data, response_capacity, actual_response_size);
  if (response_size != nullptr) {
    *response_size = actual_response_size;
  }
  return success;
}

bool SPS30::_write_frame(uint8_t command, const uint8_t *data, size_t data_size) {
  uint8_t frame[MAX_TX_FRAME_SIZE] = {};
  size_t frame_index = 0;
  uint8_t checksum = static_cast<uint8_t>(SHDLC_ADDRESS + command + data_size);

  frame[frame_index++] = SHDLC_DELIMITER;
  if (!_append_stuffed(SHDLC_ADDRESS, frame, sizeof(frame), frame_index) ||
      !_append_stuffed(command, frame, sizeof(frame), frame_index) ||
      !_append_stuffed(static_cast<uint8_t>(data_size), frame, sizeof(frame), frame_index)) {
    return false;
  }

  for (size_t i = 0; i < data_size; ++i) {
    checksum = static_cast<uint8_t>(checksum + data[i]);
    if (!_append_stuffed(data[i], frame, sizeof(frame), frame_index)) {
      return false;
    }
  }

  checksum = static_cast<uint8_t>(~checksum);
  if (!_append_stuffed(checksum, frame, sizeof(frame), frame_index) ||
      frame_index >= sizeof(frame)) {
    return false;
  }
  frame[frame_index++] = SHDLC_DELIMITER;

  return _serial->write(frame, static_cast<int>(frame_index)) == static_cast<int>(frame_index);
}

bool SPS30::_read_frame(uint8_t command, uint8_t *data, size_t data_capacity, size_t &data_size) {
  uint8_t response[MAX_RESPONSE_SIZE] = {};
  size_t response_index = 0;
  bool is_in_frame = false;
  bool is_escaped = false;
  data_size = 0;
  const int64_t start_us = esp_timer_get_time();

  while ((esp_timer_get_time() - start_us) < RESPONSE_TIMEOUT_US) {
    if (_serial->available() <= 0) {
      vTaskDelay(1);
      continue;
    }

    const int value = _serial->read();
    if (value < 0) {
      continue;
    }
    const uint8_t byte = static_cast<uint8_t>(value);

    if (!is_in_frame) {
      if (byte == SHDLC_DELIMITER) {
        is_in_frame = true;
        response_index = 0;
        is_escaped = false;
      }
      continue;
    }

    if (byte == SHDLC_DELIMITER) {
      if (is_escaped || response_index == 0) {
        response_index = 0;
        is_escaped = false;
        continue;
      }

      if (response_index < 5 || response[0] != SHDLC_ADDRESS || response[1] != command) {
        ESP_LOGE(TAG, "Command 0x%02x response header is invalid", command);
        return false;
      }
      if ((response[2] & 0x7f) != 0) {
        ESP_LOGW(TAG, "Command 0x%02x failed with sensor state 0x%02x", command, response[2]);
        return false;
      }

      const size_t payload_size = response[3];
      if (payload_size > data_capacity || response_index != payload_size + 5) {
        ESP_LOGE(TAG, "Command 0x%02x response length is invalid", command);
        return false;
      }

      uint8_t checksum = 0;
      for (size_t i = 0; i < response_index; ++i) {
        checksum = static_cast<uint8_t>(checksum + response[i]);
      }
      if (checksum != UINT8_MAX) {
        ESP_LOGE(TAG, "Command 0x%02x response checksum is invalid", command);
        return false;
      }

      if (payload_size > 0) {
        memcpy(data, &response[4], payload_size);
      }
      data_size = payload_size;
      return true;
    }

    uint8_t unstuffed_byte = byte;
    if (is_escaped) {
      unstuffed_byte = static_cast<uint8_t>(byte ^ SHDLC_ESCAPE_MASK);
      if (!is_reserved_byte(unstuffed_byte)) {
        ESP_LOGE(TAG, "Command 0x%02x response escape sequence is invalid", command);
        return false;
      }
      is_escaped = false;
    } else if (byte == SHDLC_ESCAPE) {
      is_escaped = true;
      continue;
    } else if (byte == SHDLC_XON || byte == SHDLC_XOFF) {
      ESP_LOGE(TAG, "Command 0x%02x response contains an unescaped control byte", command);
      return false;
    }

    if (response_index >= sizeof(response)) {
      ESP_LOGE(TAG, "Command 0x%02x response is too large", command);
      return false;
    }
    response[response_index++] = unstuffed_byte;
  }

  if (is_in_frame) {
    ESP_LOGE(TAG, "Command 0x%02x response parsing timed out", command);
  } else {
    ESP_LOGE(TAG, "Command 0x%02x received no response", command);
  }
  return false;
}

bool SPS30::_append_stuffed(uint8_t value, uint8_t *frame, size_t frame_size, size_t &frame_index) {
  if (is_reserved_byte(value)) {
    if (frame_index + 2 > frame_size) {
      return false;
    }
    frame[frame_index++] = SHDLC_ESCAPE;
    frame[frame_index++] = static_cast<uint8_t>(value ^ SHDLC_ESCAPE_MASK);
    return true;
  }

  if (frame_index >= frame_size) {
    return false;
  }
  frame[frame_index++] = value;
  return true;
}

float SPS30::_read_float(const uint8_t *data) {
  const uint32_t bits = (static_cast<uint32_t>(data[0]) << 24) |
                        (static_cast<uint32_t>(data[1]) << 16) |
                        (static_cast<uint32_t>(data[2]) << 8) | static_cast<uint32_t>(data[3]);
  float value;
  memcpy(&value, &bits, sizeof(value));
  return value;
}
